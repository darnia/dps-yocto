## conf/layer.conf
```bitbake
# We have a conf and classes directory, append to BBPATH
BBPATH .= ":${LAYERDIR}"

# We have a recipes directory, add to BBFILES
BBFILES += " \
    ${LAYERDIR}/recipes-*/*/*.bb \
    ${LAYERDIR}/recipes-*/*/*.bbappend \
    ${LAYERDIR}/images/*.bb \
"

BBFILE_COLLECTIONS += "meta-dps"
BBFILE_PATTERN_meta-dps := "^${LAYERDIR}/"
BBFILE_PRIORITY_meta-dps = "16"

LAYERSERIES_COMPAT_meta-dps = "warrior"
```

## conf/machine/opi-r1.conf
```bitbake
#@TYPE: Machine
#@NAME: orange-pi-r1
#@DESCRIPTION: Machine configuration for the orange-pi-r1, base on allwinner H2+ (H3) CPU

require conf/machine/include/sun8i.inc

MACHINE_FEATURES += "wifi ext2 vfat"

KERNEL_DEVICETREE = "sun8i-h2-plus-orangepi-r1.dtb"
UBOOT_MACHINE = "orangepi_r1_defconfig"

WKS_FILE = "orange-pi.wks"

IMAGE_BOOT_FILES = "boot.scr uImage sun8i-h2-plus-orangepi-r1.dtb"

DEFAULTTUNE = "cortexa7hf-neon-vfpv4"
```

## conf/machine/opi0.conf
```bitbake
#@TYPE: Machine
#@NAME: orange-pi-zero
#@DESCRIPTION: Machine configuration for the orange-pi-zero, base on allwinner H2+ (H3) CPU

require conf/machine/include/sun8i.inc

MACHINE_FEATURES += "wifi ext2 vfat"

KERNEL_DEVICETREE = "sun8i-h2-plus-orangepi-zero.dtb"
UBOOT_MACHINE = "orangepi_zero_defconfig"

WKS_FILE = "orange-pi.wks"

#IMAGE_INSTALL += "xradio xradio-firmware"
IMAGE_INSTALL += "xradio-firmware"
IMAGE_BOOT_FILES = "boot.scr uImage sun8i-h2-plus-orangepi-zero.dtb"

DEFAULTTUNE = "cortexa7hf-neon-vfpv4"
```
